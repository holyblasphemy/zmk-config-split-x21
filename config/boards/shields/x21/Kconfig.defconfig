## config/boards/shields/x21/Kconfig.defconfig
```kconfig
if SHIELD_X21_LEFT

config ZMK_KEYBOARD_NAME
    default "X21 Left"

endif

if SHIELD_X21_RIGHT

config ZMK_KEYBOARD_NAME
    default "X21 Right"

endif
```

## config/boards/shields/x21/Kconfig.shield
```kconfig
config SHIELD_X21_LEFT
    def_bool $(shields_list_contains,x21_left)

config SHIELD_X21_RIGHT
    def_bool $(shields_list_contains,x21_right)
```
